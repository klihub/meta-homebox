## conf/bblayers.conf.sample
```bitbake
# LAYER_CONF_VERSION is increased each time build/conf/bblayers.conf
# changes incompatibly
LCONF_VERSION = "11"

BBPATH = "${TOPDIR}"
BBFILES ?= ""

HOMEBOX_LAYERS = " \
    ##OEROOT##/meta \
    ##OEROOT##/meta-selftest \
    ##OEROOT##/../meta-openembedded/meta-networking \
    ##OEROOT##/../meta-openembedded/meta-oe \
    ##OEROOT##/../meta-openembedded/meta-filesystems \
    ##OEROOT##/../meta-openembedded/meta-perl \
    ##OEROOT##/../meta-openembedded/meta-python \
    ##OEROOT##/../meta-alix \
    ##OEROOT##/../meta-homebox \
"

BBLAYERS = "${HOMEBOX_LAYERS}"
BBLAYERS_NON_REMOVABLE ?= "${HOMEBOX_LAYERS}"
```

## conf/distro/distro-metadata.inc
```bitbake
DISTRO = "homebox"
DISTRO_NAME = "Home Box"
DISTRO_VERSION ?= "homebox.0"

MAINTAINER = "Krisztian Litkey <kli@iki.fi>"
TARGET_VENDOR = "-homebox"
```

## conf/distro/features/systemd.inc
```bitbake
DISTRO_FEATURES_append = " systemd"

VIRTUAL-RUNTIME_init_manager = "systemd"
VIRTUAL-RUNTIME_initscripts = ""
DISTRO_FEATURES_BACKFILL_CONSIDERED = "sysvinit"

# Prefer systemd way of creating getty@.service symlinks.
PACKAGECONFIG_append_pn-systemd = " serial-getty-generator"
```

## conf/distro/homebox.conf
```bitbake
# Set distro metadata (name, version, maintainer, etc.).
require conf/distro/homebox/distro-metadata.inc

# Set SDK settings.
require conf/distro/homebox/sdk.inc

# Disable generating static libraries.
require conf/distro/include/no-static-libs.inc

# Set up security-related compilation flags.
require conf/distro/homebox/security-flags.inc

# We use glibc.
require conf/distro/features/glibc.inc

# We want our distro fedoraesque, with /usr merged into /.
require conf/distro/features/usrmerge.inc

# Use systemd as exclusive init system.
require conf/distro/features/systemd.inc

# Use PAM for authentication.
require conf/distro/features/pam.inc

# Use static/pregenerated user and group IDs.
require conf/distro/homebox/static-xids.inc

# QA settings.
require conf/distro/homebox/qa.inc

# Exclude known broken packages from the build.
require conf/distro/homebox/exclude-broken.inc

# Re-use uninative shim released by Yocto Project / OE.
require conf/distro/homebox/uninative.inc

# Do we really need this ?
INHERIT += "homebox-update-alternatives"
```

## conf/distro/homebox/qa.inc
```bitbake
# Set stricter than default QA checks.

CONVERT_TO_ERRORS = " \
    already-stripped \
    compile-host-path \
    install-host-path \
    installed-vs-shipped \
    ldflags \
    pn-overrides \
    rpaths \
    staticdev \
    useless-rpaths \
    build-deps \
"

WARN_QA_remove = "${CONVERT_TO_ERRORS}"
ERROR_QA_append = " ${CONVERT_TO_ERRORS}"
```

## conf/distro/homebox/static-xids.inc
```bitbake
USERADDEXTENSION = "useradd-staticids"
USERADD_ERROR_SYNAMIC ??= "error"
USERADD_UID_TABLES += "conf/distro/homebox/passwd"
USERADD_GID_TABLES += "conf/distro/homebox/group"
```

## conf/distro/homebox/uninative.inc
```bitbake
# Re-use uninative shim by the Yocto Project / OE.
require conf/distro/include/yocto-uninative.inc
INHERIT += "uninative"
```

## conf/distro/include/exclude-broken.inc
```bitbake
HOMEBOX_REMOVE_PACKAGES ?= " \
    oprofileui-server \
    lttng-tools \
"

RDEPENDS_packagegroup-core-device-devel_remove_pn-packagegroup-core-device-devel = "${HOMEBOX_REMOVE_PACKAGES}"
RDEPENDS_packagegroup-core-tools-profile_remove_pn-packagegroup-core-tools-profile = "${HOMEBOX_REMOVE_PACKAGES}"
```

## conf/distro/sdk.inc
```bitbake
# This does not matter ATM, I don't need/want and SDK built.
SDK_VENDOR = "-homeboxsdk"
SDK_VERSION := "homebox.0"
SDK_NAME = "${DISTRO}-${TCLIBC}-${SDK_ARCH}-${IMAGE_BASENAME}-${TUNE_PKGARCH}"
SDK_EXT_TYPE = "minimal"
```

## conf/layer.conf
```bitbake
# We have a conf and classes directory, add to BBPATH. Add it at the
# front because we want to override files like fs-perms.txt.
BBPATH =. "${LAYERDIR}:"

# We have recipes-* directories, add to BBFILES
BBFILES += " \
    ${LAYERDIR}/recipes-*/*/*.bb \
    ${LAYERDIR}/recipes-*/*/*.bbappend \
    ${LAYERDIR}/fixes/*/recipes-*/*/*.bb \
    ${LAYERDIR}/fixes/*/recipes-*/*/*.bbappend \
    ${LAYERDIR}/fixes/*/recipes-*/*/*/*.bb \
    ${LAYERDIR}/fixes/*/recipes-*/*/*/*.bbappend \
"

# Set a variable to get to the top of the HomeBox metadata location.
META_HOMEBOX_BASE := '${LAYERDIR}'

BBFILE_COLLECTIONS += "homebox"
BBFILE_PATTERN_homebox := "^${LAYERDIR}/"
BBFILE_PRIORITY_homebox = "6"

# This and the corresponding CONF_VERSION value in local.conf.sample
# need to be increased by one each time a change is made to
# local.conf.sample that requires manually updating a local.conf after
# updating the meta data.
#
# A separate, HomeBox specific variable is used to make the value
# available to derived distros.
HOMEBOX_LOCALCONF_VERSION = "3"
LOCALCONF_VERSION = "${HOMEBOX_LOCALCONF_VERSION}"

# Same for LCONF_VERSION in bblayer.conf.sample.
HOMEBOX_LAYER_CONF_VERSION = "11"
LAYER_CONF_VERSION = "${HOMEBOX_LAYER_CONF_VERSION}"

# The default error messages use shell meta* wildcards to find the
# conf files which in our case happen to match two files (one from
# meta and the real one from meta-homebox). Be more specific to avoid
# user confusion.
SANITY_LOCALCONF_SAMPLE = "${META_HOMEBOX_BASE}/conf/local.conf.sample"
SANITY_BBLAYERCONF_SAMPLE = "${META_HOMEBOX_BASE}/conf/bblayers.conf.sample"

# Corresponds to bblayers.conf.sample.
LAYERDEPENDS_homebox = " \
    core \
    selftest \
    filesystems-layer \
    networking-layer \
    openembedded-layer \
    perl-layer \
    meta-python \
"
```

## conf/local.conf.sample
```bitbake
#
# Machine Selection
#
# By default build for alix
#

MACHINE ??= "alix"

# Image formats
#
# By default build a WIC image and an accompanying bmap files for efficient
# writing to real storage media by bmaptool.
#

HOMEBOX_IMAGE_TYPES = "wic.xz wic.bmap"

#
# Where to put downloaded tarballs/artefacts, sstate cache, and build output.
#

DL_DIR ?= "${TOPDIR}/downloads"
SSTATE_DIR ?= "${TOPDIR}/sstate-cache"
# TMPDIR ?= "${TOPDIR}/tmp"

#
# Default distro (policy config).
#

DISTRO ?= "homebox"

#
# Package Management Configuration
#

PACKAGE_CLASSES ?= "package_ipk"

#
# Extra image configuration defaults
#
#  "dbg-pkgs"       - add -dbg packages for all installed packages
#                     (adds symbol information for debugging/profiling)
#  "dev-pkgs"       - add -dev packages for all installed packages
#                     (useful if you want to develop against libs in the image)
#  "tools-sdk"      - add development tools (gcc, make, pkgconfig etc.)
#  "tools-debug"    - add debugging tools (gdb, strace)
#  "tools-profile"  - add profiling tools (oprofile, exmap, lttng, valgrind)
#  "tools-testapps" - add useful testing tools (ts_print, aplay, arecord etc.)
#  "debug-tweaks"   - make an image suitable for development
#

HOMEBOX_IMAGE_EXTRA_FEATURES = "tools-debug debug-tweaks"

#
# Additional image features
#
# The following is a list of additional classes to use when building images which
# enable extra features. Some available options which can be included in this variable
# are:
#   - 'buildstats' collect build statistics
#   - 'image-mklibs' to reduce shared library files size for an image
#   - 'image-prelink' in order to prelink the filesystem image
#   - 'image-swab' to perform host system intrusion detection
# NOTE: if listing mklibs & prelink both, then make sure mklibs is before prelink
# NOTE: mklibs also needs to be explicitly enabled for a given image, see local.conf.extended

USER_CLASSES ?= "buildstats image-mklibs"

#
# Interactive shell configuration
#

PATCHRESOLVE = "noop"

#
# Disk Space Monitoring during the build
#

BB_DISKMON_DIRS ?= "\
    STOPTASKS,${TMPDIR},1G,100K \
    STOPTASKS,${DL_DIR},1G,100K \
    STOPTASKS,${SSTATE_DIR},1G,100K \
    ABORT,${TMPDIR},100M,1K \
    ABORT,${DL_DIR},100M,1K \
    ABORT,${SSTATE_DIR},100M,1K"

# CONF_VERSION is increased each time build/conf/ changes incompatibly and is used to
# track the version of this file when it was generated. This can safely be ignored if
# this doesn't mean anything to you.
CONF_VERSION = "3"
```
